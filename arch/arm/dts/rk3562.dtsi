// SPDX-License-Identifier: (GPL-2.0+ OR MIT)

/ {
	aliases {
		pwm0 = &pwm0;
		pwm1 = &pwm1;
		pwm2 = &pwm2;
		pwm3 = &pwm3;
		pwm4 = &pwm4;
		pwm5 = &pwm5;
		pwm6 = &pwm6;
		pwm7 = &pwm7;
		pwm8 = &pwm8;
		pwm9 = &pwm9;
		pwm10 = &pwm10;
		pwm11 = &pwm11;
		pwm12 = &pwm12;
		pwm13 = &pwm13;
		pwm14 = &pwm14;
		pwm15 = &pwm15;
		i2c0 = &i2c0;
		i2c1 = &i2c1;
		i2c2 = &i2c2;
		i2c3 = &i2c3;
		i2c4 = &i2c4;
		i2c5 = &i2c5;
		uart0 = &uart0;
		//uart1 = &uart1;
		//uart2 = &uart2;
		//uart3 = &uart3;
		//uart4 = &uart4;
		//uart5 = &uart5;
		//uart6 = &uart6;
		//uart7 = &uart7;
		//uart8 = &uart8;
		//uart9 = &uart9;
		spi0 = &spi0;
		spi1 = &spi1;
		spi2 = &spi2;
		spi3 = &sfc;
		mmc0 = &sdhci;
		mmc1 = &sdmmc0;
//		ethernet0 = &gmac0;
//		ethernet1 = &gmac1;
	};
};
