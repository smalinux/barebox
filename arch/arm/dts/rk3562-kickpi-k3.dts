// SPDX-License-Identifier: (GPL-2.0+ OR MIT)
/*
 * Copyright (c) 2021 Rockchip Electronics Co., Ltd.
 *
 */

/dts-v1/;

#include <arm64/rockchip/rk3562-kickpi-k3.dts>
#include "rk3562.dtsi"

/ {
	aliases {
		i2c0  = &i2c0;
		i2c5  = &i2c5;
		mmc0  = &sdhci;
		mmc1  = &sdmmc0;
		spi0  = &spi0;
		spi1  = &spi1;
		spi2  = &spi2;
		spi3  = &sfc;
		uart0 = &uart0;
	};

	/* Hardcode until we have DMC driver support */
	memory@a00000 {
		device_type = "memory";
		reg = <0x0 0x00a00000 0x0 0x7f600000>;
	};
};
